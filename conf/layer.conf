## conf/layer.conf
```bitbake
# We have a conf and classes directory, add to BBPATH
BBPATH .= ":${LAYERDIR}"

# We have recipes-* directories, add to BBFILES
BBFILES += "${LAYERDIR}/recipes-*/*/*.bb \
	${LAYERDIR}/recipes-*/*/*.bbappend"

BBFILE_COLLECTIONS += "sc-gateway"
BBFILE_PATTERN_sc-gateway = "^${LAYERDIR}/"
BBFILE_PRIORITY_sc-gateway = "10"

LAYERDEPENDS_sc-gateway += "meta-sunxi"
LAYERDEPENDS_sc-gateway += "sota"


LAYERSERIES_COMPAT_sc-gateway = "honister"
```

## conf/machine/sc-gateway.conf
```bitbake
#@TYPE: Machine
#@NAME: orange-pi-one
#@DESCRIPTION: Machine configuration for the orange-pi-one, base on allwinner H3 CPU

require conf/machine/include/sun8i.inc

KERNEL_DEVICETREE = "sun8i-h2-plus-orangepi-zero-sc-gateway.dtb"
UBOOT_MACHINE = "orangepi_zero_defconfig"

DISTRO_FEATURES:remove = "x11 wayland"

SOTA_MACHINE:sc-gateway = "sc-gateway"
SOTA_DEPLOY_CREDENTIALS = "1"

DISTRO_FEATURES:append = " systemd"
DISTRO_FEATURES_BACKFILL_CONSIDERED:append = " sysvinit"
VIRTUAL-RUNTIME_init_manager = "systemd"
VIRTUAL-RUNTIME_initscripts = "systemd-compat-units"
```
